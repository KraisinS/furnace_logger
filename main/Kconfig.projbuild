## main/Kconfig.projbuild
```kconfig
menu "Oven Temperature Logger Configuration"

menu "Sensor Read Configuration"
    config SENSOR_READ_INTERVAL
        int "Sensor read interval (milliseconds)"
        default 1000
        range 100 10000
        help
            Interval between temperature updates.
endmenu

menu "MAX6675 Temperature Sensors"
    config MAX6675_SENSOR1_MISO_PIN
        int "MAX6675 Sensor 1 SO (MISO) GPIO pin"
        default 19
        help
            Sensor 1 data output pin.

    config MAX6675_SENSOR1_CLK_PIN
        int "MAX6675 Sensor 1 SCK (CLK) GPIO pin"
        default 18
        help
            Sensor 1 clock pin.

    config MAX6675_SENSOR1_CS_PIN
        int "MAX6675 Sensor 1 CS GPIO pin"
        default 5
        help
            Chip Select pin for MAX6675 sensor 1 (Entrance).

    config MAX6675_SENSOR2_MISO_PIN
        int "MAX6675 Sensor 2 SO (MISO) GPIO pin"
        default 34
        help
            Sensor 2 data output pin. GPIO34 is input-only, ideal for MISO.

    config MAX6675_SENSOR2_CLK_PIN
        int "MAX6675 Sensor 2 SCK (CLK) GPIO pin"
        default 23
        help
            Sensor 2 clock pin.

    config MAX6675_SENSOR2_CS_PIN
        int "MAX6675 Sensor 2 CS GPIO pin"
        default 4
        help
            Chip Select pin for MAX6675 sensor 2 (Middle).

    config MAX6675_SENSOR3_MISO_PIN
        int "MAX6675 Sensor 3 SO (MISO) GPIO pin"
        default 27
        help
            Sensor 3 data output pin.

    config MAX6675_SENSOR3_CLK_PIN
        int "MAX6675 Sensor 3 SCK (CLK) GPIO pin"
        default 13
        help
            Sensor 3 clock pin.

    config MAX6675_SENSOR3_CS_PIN
        int "MAX6675 Sensor 3 CS GPIO pin"
        default 15
        help
            Chip Select pin for MAX6675 sensor 3 (Exit).
endmenu

menu "TM1637 Display Configuration"
    config TM1637_DISPLAY1_CLK_PIN
        int "TM1637 Display 1 CLK GPIO pin"
        default 22
        help
            GPIO pin connected to TM1637 Display 1 CLK.

    config TM1637_DISPLAY1_DIO_PIN
        int "TM1637 Display 1 DIO GPIO pin"
        default 21
        help
            GPIO pin connected to TM1637 Display 1 DIO.

    config TM1637_DISPLAY2_CLK_PIN
        int "TM1637 Display 2 CLK GPIO pin"
        default 25
        help
            GPIO pin connected to TM1637 Display 2 CLK.

    config TM1637_DISPLAY2_DIO_PIN
        int "TM1637 Display 2 DIO GPIO pin"
        default 26
        help
            GPIO pin connected to TM1637 Display 2 DIO.

    config TM1637_DISPLAY3_CLK_PIN
        int "TM1637 Display 3 CLK GPIO pin"
        default 32
        help
            GPIO pin connected to TM1637 Display 3 CLK.

    config TM1637_DISPLAY3_DIO_PIN
        int "TM1637 Display 3 DIO GPIO pin"
        default 33
        help
            GPIO pin connected to TM1637 Display 3 DIO.

    config TM1637_BRIGHTNESS
        int "TM1637 brightness (0-7)"
        default 4
        range 0 7
        help
            Display brightness level for all displays. 0 is dimmest, 7 is brightest.
endmenu

menu "SD Card Logging"
    config ENABLE_SD_LOGGING
        bool "Enable SD card logging"
        default y
        help
            Mount SD card over SPI and periodically append temperatures to CSV files.

    config SD_SPI_MISO_PIN
        int "SD card SPI MISO GPIO pin"
        default 35
        help
            MISO pin for SD card SPI interface.

    config SD_SPI_MOSI_PIN
        int "SD card SPI MOSI GPIO pin"
        default 14
        help
            MOSI pin for SD card SPI interface.

    config SD_SPI_CLK_PIN
        int "SD card SPI CLK GPIO pin"
        default 12
        help
            CLK pin for SD card SPI interface.

    config SD_SPI_CS_PIN
        int "SD card SPI CS GPIO pin"
        default 2
        help
            CS pin for SD card SPI interface.

    config SD_LOG_INTERVAL_SECONDS
        int "SD log interval (seconds)"
        default 60
        range 1 3600
        help
            Interval for appending one row of temperatures to the daily CSV file.

    config SD_LOG_RETENTION_DAYS
        int "Days of logs to keep"
        default 1825
        range 1 3650
        help
            Log files older than this are deleted during startup cleanup.

    config ENABLE_TIME_SYNC
        bool "Enable WiFi SNTP time sync at startup"
        default y
        help
            Connect to WiFi briefly at startup and synchronize time via NTP.

    config TIME_SYNC_WIFI_SSID
        string "Time sync WiFi SSID"
        default ""
        help
            WiFi SSID used for startup SNTP sync.

    config TIME_SYNC_WIFI_PASSWORD
        string "Time sync WiFi password"
        default ""
        help
            WiFi password used for startup SNTP sync.

    config TIME_SYNC_NTP_SERVER
        string "NTP server"
        default "pool.ntp.org"
        help
            NTP server used for setting ESP32 system time.

    config TIME_SYNC_TIMEOUT_SECONDS
        int "Time sync timeout (seconds)"
        default 20
        range 5 120
        help
            Maximum wait time for WiFi connect and SNTP synchronization.

    config ENABLE_SD_LOG_HTTP
        bool "Enable SD log HTTP server"
        default y
        help
            Keep WiFi connected and serve SD log files over HTTP.
            Endpoints:
              - /logs (file listing)
              - /download?f=YYYY-MM-DD.csv (download file)

    config SD_LOG_HTTP_PORT
        int "SD log HTTP server port"
        depends on ENABLE_SD_LOG_HTTP
        default 80
        range 1 65535
        help
            TCP port used by the SD log HTTP server.
endmenu

endmenu
```
